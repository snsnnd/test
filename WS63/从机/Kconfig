## WS63/从机/Kconfig
```kconfig
# application/JS/Kconfig
config ENABLE_JS_APP
    bool "Enable JS Application"
    default y
    help
      This is the pure custom JS application for WS63.
```

## WS63/管理/Kconfig
```kconfig
config ENABLE_JS_MASTER_APP
    bool "Enable JS Master Application"
    default n
    help
      Build the WS63 SLE client/master demo used to connect to the JS slave node.
```
